/*
 * Copyright (c) 2024 Analog Devices, Inc.
 * SPDX-License-Identifier: Apache-2.0
 */

/ {
    buttons {
        dip_sw: dip {
            gpios = <&gpio0 19 0>, <&gpio0 18 0>, <&gpio0 15 0>;
            label = "DIP Switch";
            status = "okay";
        };
    };
};
