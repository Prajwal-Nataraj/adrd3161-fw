## boards/adi/adrd3161/Kconfig.adrd3161
```kconfig
# Copyright (c) 2024, 2025 Analog Devices, Inc.
# SPDX-License-Identifier: Apache-2.0

config BOARD_ADRD3161
    select SOC_MAX32662
```

## boards/adi/adrd3161/board.yml
```yaml
board:
  name: adrd3161
  full_name: ADRD3161 Motor Control module
  vendor: adi
  revision:
    format: letter
    default: B
    revisions:
    - name: A
    - name: B
  socs:
  - name: max32662
```

## drivers/misc/Kconfig
```kconfig
# Copyright (c) 2025 Analog Devices, Inc.
# SPDX-License-Identifier: Apache-2.0

menu "Miscellaneous Drivers"

rsource "tmc9660/Kconfig"

endmenu
```

## drivers/misc/tmc9660/Kconfig
```kconfig
# Copyright (c) 2025 Analog Devices, Inc.
# SPDX-License-Identifier: Apache-2.0

DT_COMPAT_ADI_TMC9660_SPI := adi,tmc9660-spi

config TMC9660_SPI
	bool "TMC9660, communication over SPI"
	depends on SPI
	select APPLICATION_DEFINED_SYSCALL
	default $(dt_compat_enabled,$(DT_COMPAT_ADI_TMC9660_SPI))
	help
		TMC9660, communication over SPI

module = TMC9660_SPI
module-dep = LOG
module-str = Log level for TMC9660 SPI driver
module-help = Sets log level for TMC9660 SPI driver
source "subsys/logging/Kconfig.template.log_config"
```

## dts/bindings/misc/adi,tmc9660-spi.yaml
```yaml
# Copyright (c) 2025 Analog Devices, Inc.
# SPDX-License-Identifier: Apache-2.0

description: TMC9660 Smart Gate Driver with Servo (FOC) Controller, communication over SPI

include:
  - name: spi-device.yaml

compatible: "adi,tmc9660-spi"
```

## west.yml
```yaml
manifest:
  version: 0.7
  remotes:
    - name: analogdevicesinc
      url-base: https://github.com/analogdevicesinc
    - name: zephyrproject-rtos
      url-base: https://github.com/zephyrproject-rtos
    - name: NTURacingTeam
      url-base: https://github.com/NTURacingTeam
  defaults:
    remote: zephyrproject-rtos
  projects:
    - name: zephyr
      remote: analogdevicesinc
      revision: 3b8c8cb54d685472ed4b4f8e50fceef92d8405c9
      import:
        name-allowlist:
          - hal_adi
          - cmsis_6
    - name: canopennode
      remote: NTURacingTeam
      revision: 2487004b06e035efe211ee1a80e5b19a63530d78
      path: modules/canopennode
  self:
    path: adrd3161-fw
```
